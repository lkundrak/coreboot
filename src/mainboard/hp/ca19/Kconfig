## src/mainboard/hp/ca19/Kconfig
```kconfig
if BOARD_HP_NEOWARE_CA19

config BOARD_SPECIFIC_OPTIONS # dummy
	def_bool y
	select CPU_VIA_C7
	select NORTHBRIDGE_VIA_CN700
	select SOUTHBRIDGE_VIA_VT8237R
	select SUPERIO_WINBOND_W83697HF
	select HAVE_PIRQ_TABLE
	select HAVE_OPTION_TABLE
	select BOARD_ROMSIZE_KB_512

config MAINBOARD_DIR
	string
	default hp/ca19

config MAINBOARD_PART_NUMBER
	string
	default "Neoware CA19"

config IRQ_SLOT_COUNT
	int
	default 10

endif # BOARD_HP_NEOWARE_CA19
```

## src/mainboard/hp/t5550/Kconfig
```kconfig
##
## This file is part of the coreboot project.
##
## Copyright (C) 2011-2012  Alexandru Gagniuc <mr.nuke.me@gmail.com>
##
## This program is free software: you can redistribute it and/or modify
## it under the terms of the GNU General Public License as published by
## the Free Software Foundation, either version 2 of the License, or
## (at your option) any later version.
##
## This program is distributed in the hope that it will be useful,
## but WITHOUT ANY WARRANTY; without even the implied warranty of
## MERCHANTABILITY or FITNESS FOR A PARTICULAR PURPOSE.  See the
## GNU General Public License for more details.
##

if BOARD_HP_T5550

config BOARD_SPECIFIC_OPTIONS # dummy
	def_bool y
	select CPU_VIA_NANO
	select NORTHBRIDGE_VIA_VX900
	select SUPERIO_VIA_VT1211
	select HAVE_PIRQ_TABLE
	select PIRQ_ROUTE
	select HAVE_MP_TABLE
	#select HAVE_OPTION_TABLE
	#select HAVE_ACPI_TABLES
	#select HAVE_ACPI_RESUME
	#select BOARD_HAS_FADT
	select BOARD_ROMSIZE_KB_1024

config MAINBOARD_DIR
	string
	default hp/t5550

config MAINBOARD_PART_NUMBER
	string
	default "t5550"

config IRQ_SLOT_COUNT
	int
	default 13

config BOOTBLOCK_MAINBOARD_INIT
	string
	default "mainboard/hp/t5550/bootblock.c"

endif # BOARD_HP_T5550
```

## src/mainboard/lenovo/x61/Kconfig
```kconfig
if BOARD_LENOVO_X61

config BOARD_SPECIFIC_OPTIONS # dummy
	def_bool y
	# This is in fact a CPU_INTEL_SOCKET_MPGA479M,
	# but http://permalink.gmane.org/gmane.linux.bios/64292
	select CPU_INTEL_SOCKET_MFCPGA478
	# I965PM
	select NORTHBRIDGE_INTEL_I965
	# 82801HEM (ICH8M-E)
	select SOUTHBRIDGE_INTEL_I82801HX
	# 05:00.0 CardBus bridge: Ricoh Co Ltd RL5c476 II (rev ba)
	select SOUTHBRIDGE_RICOH_RL5C476
	# Found NSC PC87382 (sid=0xf4, srid=0x04) at 0x164e
	select SUPERIO_NSC_PC87382
	# This one is in dock:
	select SUPERIO_NSC_PC87392
	select EC_LENOVO_PMH7
	select EC_LENOVO_H8
	# clock SLG8LP564
	select DRIVERS_ICS_954309
	select BOARD_ROMSIZE_KB_4096
	select DRIVERS_GENERIC_IOAPIC
	select HAVE_MP_TABLE
	select HAVE_ACPI_TABLES
	select EC_ACPI
	select EARLY_CBMEM_INIT
	select HAVE_OPTION_TABLE
	select HAVE_CMOS_DEFAULT
	select HAVE_ACPI_RESUME
	select MAINBOARD_HAS_NATIVE_VGA_INIT
	select MAINBOARD_HAS_NATIVE_VGA_INIT_TEXTMODECFG
	select H8_DOCK_EARLY_INIT

config MAINBOARD_DIR
	string
	default lenovo/x61

config DCACHE_RAM_BASE
	hex
	default 0xffde0000

config DCACHE_RAM_SIZE
	hex
	default 0x8000

config MAINBOARD_PART_NUMBER
	string
	default "7666WJ5"

config MAINBOARD_VERSION
	string
	default "ThinkPad X61"

config MAINBOARD_VENDOR
	string
	default "LENOVO"

config MMCONF_BASE_ADDRESS
	hex
	default 0xf0000000

config USBDEBUG_HCD_INDEX
	int
	default 2

config IRQ_SLOT_COUNT
	int
	default 18

config MAX_CPUS
	int
	default 2

endif # BOARD_LENOVO_X200
```
